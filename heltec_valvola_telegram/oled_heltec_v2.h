/*
 * OLED SSD1306 128x64 — Heltec WiFi LoRa 32 V2
 * SDA=4, SCL=15, RST=16, I2C 0x3C
 * Orientamento come esempi Heltec: flipScreenVertically (A0 + C0)
 */

#ifndef OLED_HELTEC_V2_H
#define OLED_HELTEC_V2_H

#include <Wire.h>
#include <string.h>

#define OLED_I2C_ADDR 0x3C
#define OLED_W 128
#define OLED_H 64

static uint8_t oledBuffer[OLED_W * OLED_H / 8];

static void oledWriteCommand(uint8_t cmd) {
  Wire.beginTransmission(OLED_I2C_ADDR);
  Wire.write((uint8_t)0x00);
  Wire.write(cmd);
  Wire.endTransmission();
}

static void oledWriteData(const uint8_t* data, size_t len) {
  const size_t chunk = 16;
  for (size_t offset = 0; offset < len; offset += chunk) {
    size_t n = (len - offset > chunk) ? chunk : (len - offset);
    Wire.beginTransmission(OLED_I2C_ADDR);
    Wire.write((uint8_t)0x40);
    for (size_t i = 0; i < n; i++) {
      Wire.write(data[offset + i]);
    }
    Wire.endTransmission();
  }
}

static void oledInitPins(uint8_t sda, uint8_t scl, uint8_t rst) {
  pinMode(rst, OUTPUT);
  digitalWrite(rst, LOW);
  delay(20);
  digitalWrite(rst, HIGH);
  delay(20);

  Wire.begin(sda, scl);

  const uint8_t initSeq[] = {
    0xAE,
    0xD5, 0x80,
    0xA8, 0x3F,
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    0xA6,
    0xAF
  };

  for (uint8_t i = 0; i < sizeof(initSeq); i++) {
    oledWriteCommand(initSeq[i]);
  }

  // Come flipScreenVertically() negli esempi Heltec / SSD1306Wire
  oledWriteCommand(0xA0);
  oledWriteCommand(0xC0);

  memset(oledBuffer, 0, sizeof(oledBuffer));
}

static void oledClear() {
  memset(oledBuffer, 0, sizeof(oledBuffer));
}

static void oledPush() {
  for (uint8_t page = 0; page < 8; page++) {
    oledWriteCommand(0xB0 + page);
    oledWriteCommand(0x00);
    oledWriteCommand(0x10);
    oledWriteData(&oledBuffer[(uint16_t)page * OLED_W], OLED_W);
  }
}

static const uint8_t font5x7[][5] = {
  {0x00,0x00,0x00,0x00,0x00},
  {0x00,0x00,0x5F,0x00,0x00},
  {0x00,0x07,0x00,0x07,0x00},
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  {0x61,0x51,0x49,0x45,0x43},
};

static char oledNormChar(char c) {
  if (c >= 'a' && c <= 'z') {
    c = (char)(c - 32);
  }
  if (c < 32 || c > 90) {
    return '?';
  }
  return c;
}

static void oledDrawChar(int x, int y, char c) {
  c = oledNormChar(c);
  const uint8_t* glyph = font5x7[c - 32];
  for (int col = 0; col < 5; col++) {
    uint8_t line = glyph[col];
    for (int row = 0; row < 7; row++) {
      if (line & (1 << row)) {
        int px = x + col;
        int py = y + row;
        if (px >= 0 && px < OLED_W && py >= 0 && py < OLED_H) {
          oledBuffer[px + (py / 8) * OLED_W] |= (1 << (py & 7));
        }
      }
    }
  }
}

static void oledDrawString(int x, int y, const char* text) {
  int cursor = x;
  while (*text) {
    oledDrawChar(cursor, y, *text++);
    cursor += 6;
  }
}

// Font compatto: stesso 5x7, interlinea 8 px → 6 righe su 64 px
static void oledDrawStringCompact(int x, int y, const char* text) {
  int cursor = x;
  while (*text) {
    oledDrawChar(cursor, y, *text++);
    cursor += 5;
  }
}

static void oledShowLines(const char* l1, const char* l2, const char* l3, const char* l4) {
  oledClear();
  oledDrawString(0, 0, l1);
  oledDrawString(0, 16, l2);
  oledDrawString(0, 32, l3);
  oledDrawString(0, 48, l4);
  oledPush();
}

static void oledShowLinesCompact(
  const char* l1, const char* l2, const char* l3,
  const char* l4, const char* l5, const char* l6) {
  oledClear();
  oledDrawStringCompact(0, 0, l1);
  oledDrawStringCompact(0, 8, l2);
  oledDrawStringCompact(0, 16, l3);
  oledDrawStringCompact(0, 24, l4);
  oledDrawStringCompact(0, 32, l5);
  oledDrawStringCompact(0, 40, l6);
  oledPush();
}

#endif
